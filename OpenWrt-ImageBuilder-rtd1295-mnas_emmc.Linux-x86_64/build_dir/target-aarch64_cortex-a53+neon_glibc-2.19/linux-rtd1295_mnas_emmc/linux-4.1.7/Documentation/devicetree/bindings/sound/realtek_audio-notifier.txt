## OpenWrt-ImageBuilder-rtd1295-mnas_emmc.Linux-x86_64/build_dir/target-aarch64_cortex-a53+neon_glibc-2.19/linux-rtd1295_mnas_emmc/linux-4.1.7/Documentation/devicetree/bindings/sound/realtek_audio-notifier.txt
```
Realtek Audio Notifier DT-bindings

* Common

Required properties:

- compatible : shall contain one of the followings:
	"alc5279",
	"wm8782",
	"realtek,audio-in", for Audio-In devices, and

	"realtek,audio-out", for Audio-out devices.

* AI device
Optional properties (deprecated):

- reg : shall contain muxpad0 address.

- muxpad0 : shall contain the value of muxpad0.

Example :

	wm8782 {
		compatible = wm8782";
		status = "okay";
	};

* AO device

Sub-node

Required properties:

- compatible : shall contain one of the followings:
	"dac",
	"spdif",
	"i2s",
	"hdmi",
	"global".

Example :

	aodev {
		compatible = "realtek,audio-out";
		dac {
			compatible = "dac"
			status = "okay";
		};
		spdif {
			compatible = "spdif"
			status = "okay";
		};
		i2s {
			compatible = "i2s"
			status = "okay";
		};
		hdmi {
			compatible = "hdmi"
			status = "okay";
		};
		global {
			compatible = "global"
			status = "okay";
		};
	};
```

## linux-kernel/drivers/media/platform/rtk_hdmirx/Kconfig
```kconfig
config RTK_HDMIRX
	tristate "HDMIRX for Realtek RTD1295 platform"
	select MEDIA_CAMERA_SUPPORT
	select VIDEO_DEV
	select I2C
	select VIDEO_V4L2
	select VIDEOBUF2_CORE
	select VIDEOBUF_GEN
	select VIDEOBUF2_VMALLOC
	select VIDEOBUF2_DMA_CONTIG
	default n
	---help---
	  Say Y, if you want to enable HDMI RX driver on Realtek RTD1295 platform.

config RTK_HDCP1x_REPEATER
	tristate "HDCP 1.x Repeater for Realtek platform"
	select RTK_HDMIRX
    select RTK_HDCP_1x
	default n
	---help---
	  Say Y, if you want to enable HDCP 1.x repeater on Realtek platform.
```
